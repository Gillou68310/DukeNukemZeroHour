SECTIONS
{
    __romPos = 0x0;
    . = __romPos;
    header_ROM_START = __romPos;
    header_VRAM = ADDR(.header);
    .header : AT(header_ROM_START) SUBALIGN(16)
    {
        header_TEXT_END = .;
        header_DATA_START = .;
        header_s = .;
        build/asm/header.s.o(.data);
        header_DATA_END = .;
    }
    header_ROM_END = 0x40;
    __romPos = 0x40;

    __romPos = 0x40;
    . = __romPos;
    boot_ROM_START = __romPos;
    boot_VRAM = ADDR(.boot);
    .boot : AT(boot_ROM_START) SUBALIGN(16)
    {
        boot_TEXT_END = .;
        boot_DATA_START = .;
        boot_bin = .;
        build/assets/boot.bin.o(.data);
        boot_DATA_END = .;
    }
    boot_ROM_END = 0x1000;
    __romPos = 0x1000;

    __romPos = 0x1000;
    . = __romPos;
    main_ROM_START = __romPos;
    main_VRAM = ADDR(.main);
    .main 0x80000400 : AT(main_ROM_START) SUBALIGN(16)
    {
        main_TEXT_START = .;
        build/asm/entrypoint.s.o(.text);
        build/src/1050.c.o(.text);
        build/src/4590.c.o(.text);
        build/src/4600.c.o(.text);
        build/src/71F0.c.o(.text);
        build/src/9410.c.o(.text);
        build/src/16DF0.c.o(.text);
        build/src/16FF0.c.o(.text);
        build/src/17B30.c.o(.text);
        build/src/1A7C0.c.o(.text);
        build/src/1E7A0.c.o(.text);
        build/src/20490.c.o(.text);
        build/src/21500.c.o(.text);
        build/src/24610.c.o(.text);
        build/src/2ABE0.c.o(.text);
        build/src/2BAB0.c.o(.text);
        build/src/2BC40.c.o(.text);
        build/src/2BD00.c.o(.text);
        build/src/2BE90.c.o(.text);
        build/src/2C020.c.o(.text);
        build/src/2C1C0.c.o(.text);
        build/src/35D90.c.o(.text);
        build/src/35EA0.c.o(.text);
        build/src/36410.c.o(.text);
        build/src/37090.c.o(.text);
        build/src/3FAD0.c.o(.text);
        build/src/41940.c.o(.text);
        build/src/59D40.c.o(.text);
        build/src/609D0.c.o(.text);
        build/src/64530.c.o(.text);
        build/src/7A430.c.o(.text);
        build/src/7BA50.c.o(.text);
        build/src/7CBC0.c.o(.text);
        build/src/7F6A0.c.o(.text);
        build/src/7FCE0.c.o(.text);
        build/src/814D0.c.o(.text);
        build/src/82480.c.o(.text);
        build/src/84490.c.o(.text);
        build/src/87010.c.o(.text);
        build/src/88690.c.o(.text);
        build/src/8E670.c.o(.text);
        build/src/8EFE0.c.o(.text);
        build/src/95500.c.o(.text);
        build/src/A06F0.c.o(.text);
        build/src/A5580.c.o(.text);
        build/src/A8E80.c.o(.text);
        build/src/A9D60.c.o(.text);
        build/src/AA020.c.o(.text);
        build/src/AA220.c.o(.text);
        build/src/AA230.c.o(.text);
        build/src/AA3B0.c.o(.text);
        build/src/AAAC0.c.o(.text);
        build/src/AB0B0.c.o(.text);
        build/src/AB6B0.c.o(.text);
        build/src/ABA30.c.o(.text);
        build/src/ABD50.c.o(.text);
        build/src/ABE30.c.o(.text);
        build/src/AC030.c.o(.text);
        build/src/AC100.c.o(.text);
        build/src/AC4C0.c.o(.text);
        build/src/AC4F0.c.o(.text);
        build/src/AC680.c.o(.text);
        build/src/AC6B0.c.o(.text);
        build/src/AC6E0.c.o(.text);
        build/src/AC840.c.o(.text);
        build/src/AC970.c.o(.text);
        build/src/ACB70.c.o(.text);
        build/src/ACC90.c.o(.text);
        build/src/ACCD0.c.o(.text);
        build/src/ACFD0.c.o(.text);
        build/src/AD030.c.o(.text);
        build/src/ADB40.c.o(.text);
        build/src/ADC50.c.o(.text);
        build/src/ADC70.c.o(.text);
        build/src/AE090.c.o(.text);
        build/src/AE140.c.o(.text);
        build/src/AE180.c.o(.text);
        build/src/AE1D0.c.o(.text);
        build/src/AE210.c.o(.text);
        build/src/AE220.c.o(.text);
        build/src/AE4D0.c.o(.text);
        build/src/AE570.c.o(.text);
        build/src/AE6C0.c.o(.text);
        build/src/AE810.c.o(.text);
        build/src/AE860.c.o(.text);
        build/src/AE8C0.c.o(.text);
        build/src/AEC70.c.o(.text);
        build/src/AED60.c.o(.text);
        build/src/AEE70.c.o(.text);
        build/src/AEF20.c.o(.text);
        build/src/AEFB0.c.o(.text);
        build/src/AF040.c.o(.text);
        build/src/AFBA0.c.o(.text);
        build/src/B03D0.c.o(.text);
        build/src/B1C20.c.o(.text);
        build/src/B23D0.c.o(.text);
        build/src/B24F0.c.o(.text);
        build/src/B2670.c.o(.text);
        build/src/B26F0.c.o(.text);
        build/src/B2CC0.c.o(.text);
        build/src/B2EA0.c.o(.text);
        build/src/B3230.c.o(.text);
        build/src/B3660.c.o(.text);
        build/src/B3880.c.o(.text);
        build/src/B3A10.c.o(.text);
        build/src/B3B20.c.o(.text);
        build/src/B3DF0.c.o(.text);
        build/src/B3EF0.c.o(.text);
        build/src/B4330.c.o(.text);
        build/src/B4390.c.o(.text);
        build/src/B45A0.c.o(.text);
        build/src/B48B0.c.o(.text);
        build/src/B4BF0.c.o(.text);
        build/src/B4D60.c.o(.text);
        build/src/B5070.c.o(.text);
        build/src/B5090.c.o(.text);
        build/src/B5D70.c.o(.text);
        build/src/B5E20.c.o(.text);
        build/src/B5FB0.c.o(.text);
        build/src/B5FC0.c.o(.text);
        build/src/B5FD0.c.o(.text);
        build/src/B5FE0.c.o(.text);
        build/src/B60A0.c.o(.text);
        build/src/B6150.c.o(.text);
        build/src/B61C0.c.o(.text);
        build/src/B6240.c.o(.text);
        build/src/B62A0.c.o(.text);
        build/src/B6370.c.o(.text);
        build/src/B6390.c.o(.text);
        build/src/B64D0.c.o(.text);
        build/src/B6570.c.o(.text);
        build/src/B6580.c.o(.text);
        build/src/B6620.c.o(.text);
        build/src/B6640.c.o(.text);
        build/src/B66E0.c.o(.text);
        build/src/B6950.c.o(.text);
        build/src/B6970.c.o(.text);
        build/src/B69C0.c.o(.text);
        build/src/B6AD0.c.o(.text);
        build/src/B6AE0.c.o(.text);
        build/src/B6B20.c.o(.text);
        build/src/B6B60.c.o(.text);
        build/src/B6BC0.c.o(.text);
        build/src/B6C10.c.o(.text);
        build/src/B6D00.c.o(.text);
        build/src/B6E10.c.o(.text);
        build/src/B7D10.c.o(.text);
        build/src/B87A0.c.o(.text);
        build/src/B89A0.c.o(.text);
        build/src/B8BC0.c.o(.text);
        build/src/B8CB0.c.o(.text);
        build/src/B9070.c.o(.text);
        build/src/B9260.c.o(.text);
        build/src/B93D0.c.o(.text);
        build/src/B9540.c.o(.text);
        build/src/B9E70.c.o(.text);
        build/src/B9EC0.c.o(.text);
        build/src/B9F10.c.o(.text);
        build/src/B9FA0.c.o(.text);
        build/src/B9FF0.c.o(.text);
        build/src/BA080.c.o(.text);
        build/src/BA0A0.c.o(.text);
        build/src/BA0C0.c.o(.text);
        build/src/BA100.c.o(.text);
        build/src/BA3E0.c.o(.text);
        build/src/BA630.c.o(.text);
        build/src/BB0B0.c.o(.text);
        build/src/BB270.c.o(.text);
        build/src/BB490.c.o(.text);
        build/src/BB5A0.c.o(.text);
        build/src/BB670.c.o(.text);
        build/src/BB6A0.c.o(.text);
        build/asm/BB710.s.o(.text);
        build/src/BB980.c.o(.text);
        build/src/BBC40.c.o(.text);
        build/src/BBD40.c.o(.text);
        main_TEXT_END = .;
        main_DATA_START = .;
        entrypoint_s = .;
        build/asm/entrypoint.s.o(.data);
        _1050_c = .;
        build/src/1050.c.o(.data);
        _4590_c = .;
        build/src/4590.c.o(.data);
        _4600_c = .;
        build/src/4600.c.o(.data);
        _71F0_c = .;
        build/src/71F0.c.o(.data);
        _9410_c = .;
        build/src/9410.c.o(.data);
        _16DF0_c = .;
        build/src/16DF0.c.o(.data);
        _16FF0_c = .;
        build/src/16FF0.c.o(.data);
        _17B30_c = .;
        build/src/17B30.c.o(.data);
        _1A7C0_c = .;
        build/src/1A7C0.c.o(.data);
        _1E7A0_c = .;
        build/src/1E7A0.c.o(.data);
        _20490_c = .;
        build/src/20490.c.o(.data);
        _21500_c = .;
        build/src/21500.c.o(.data);
        _24610_c = .;
        build/src/24610.c.o(.data);
        _2ABE0_c = .;
        build/src/2ABE0.c.o(.data);
        _2BAB0_c = .;
        build/src/2BAB0.c.o(.data);
        _2BC40_c = .;
        build/src/2BC40.c.o(.data);
        _2BD00_c = .;
        build/src/2BD00.c.o(.data);
        _2BE90_c = .;
        build/src/2BE90.c.o(.data);
        _2C020_c = .;
        build/src/2C020.c.o(.data);
        _2C1C0_c = .;
        build/src/2C1C0.c.o(.data);
        _35D90_c = .;
        build/src/35D90.c.o(.data);
        _35EA0_c = .;
        build/src/35EA0.c.o(.data);
        _36410_c = .;
        build/src/36410.c.o(.data);
        _37090_c = .;
        build/src/37090.c.o(.data);
        _3FAD0_c = .;
        build/src/3FAD0.c.o(.data);
        _41940_c = .;
        build/src/41940.c.o(.data);
        _59D40_c = .;
        build/src/59D40.c.o(.data);
        _609D0_c = .;
        build/src/609D0.c.o(.data);
        _64530_c = .;
        build/src/64530.c.o(.data);
        _7A430_c = .;
        build/src/7A430.c.o(.data);
        _7BA50_c = .;
        build/src/7BA50.c.o(.data);
        _7CBC0_c = .;
        build/src/7CBC0.c.o(.data);
        _7F6A0_c = .;
        build/src/7F6A0.c.o(.data);
        _7FCE0_c = .;
        build/src/7FCE0.c.o(.data);
        _814D0_c = .;
        build/src/814D0.c.o(.data);
        _82480_c = .;
        build/src/82480.c.o(.data);
        _84490_c = .;
        build/src/84490.c.o(.data);
        _87010_c = .;
        build/src/87010.c.o(.data);
        _88690_c = .;
        build/src/88690.c.o(.data);
        _8E670_c = .;
        build/src/8E670.c.o(.data);
        _8EFE0_c = .;
        build/src/8EFE0.c.o(.data);
        _95500_c = .;
        build/src/95500.c.o(.data);
        A06F0_c = .;
        build/src/A06F0.c.o(.data);
        A5580_c = .;
        build/src/A5580.c.o(.data);
        A8E80_c = .;
        build/src/A8E80.c.o(.data);
        A9D60_c = .;
        build/src/A9D60.c.o(.data);
        AA020_c = .;
        build/src/AA020.c.o(.data);
        AA220_c = .;
        build/src/AA220.c.o(.data);
        AA230_c = .;
        build/src/AA230.c.o(.data);
        AA3B0_c = .;
        build/src/AA3B0.c.o(.data);
        AAAC0_c = .;
        build/src/AAAC0.c.o(.data);
        AB0B0_c = .;
        build/src/AB0B0.c.o(.data);
        AB6B0_c = .;
        build/src/AB6B0.c.o(.data);
        ABA30_c = .;
        build/src/ABA30.c.o(.data);
        ABD50_c = .;
        build/src/ABD50.c.o(.data);
        ABE30_c = .;
        build/src/ABE30.c.o(.data);
        AC030_c = .;
        build/src/AC030.c.o(.data);
        AC100_c = .;
        build/src/AC100.c.o(.data);
        AC4C0_c = .;
        build/src/AC4C0.c.o(.data);
        AC4F0_c = .;
        build/src/AC4F0.c.o(.data);
        AC680_c = .;
        build/src/AC680.c.o(.data);
        AC6B0_c = .;
        build/src/AC6B0.c.o(.data);
        AC6E0_c = .;
        build/src/AC6E0.c.o(.data);
        AC840_c = .;
        build/src/AC840.c.o(.data);
        AC970_c = .;
        build/src/AC970.c.o(.data);
        ACB70_c = .;
        build/src/ACB70.c.o(.data);
        ACC90_c = .;
        build/src/ACC90.c.o(.data);
        ACCD0_c = .;
        build/src/ACCD0.c.o(.data);
        ACFD0_c = .;
        build/src/ACFD0.c.o(.data);
        AD030_c = .;
        build/src/AD030.c.o(.data);
        ADB40_c = .;
        build/src/ADB40.c.o(.data);
        ADC50_c = .;
        build/src/ADC50.c.o(.data);
        ADC70_c = .;
        build/src/ADC70.c.o(.data);
        AE090_c = .;
        build/src/AE090.c.o(.data);
        AE140_c = .;
        build/src/AE140.c.o(.data);
        AE180_c = .;
        build/src/AE180.c.o(.data);
        AE1D0_c = .;
        build/src/AE1D0.c.o(.data);
        AE210_c = .;
        build/src/AE210.c.o(.data);
        AE220_c = .;
        build/src/AE220.c.o(.data);
        AE4D0_c = .;
        build/src/AE4D0.c.o(.data);
        AE570_c = .;
        build/src/AE570.c.o(.data);
        AE6C0_c = .;
        build/src/AE6C0.c.o(.data);
        AE810_c = .;
        build/src/AE810.c.o(.data);
        AE860_c = .;
        build/src/AE860.c.o(.data);
        AE8C0_c = .;
        build/src/AE8C0.c.o(.data);
        AEC70_c = .;
        build/src/AEC70.c.o(.data);
        AED60_c = .;
        build/src/AED60.c.o(.data);
        AEE70_c = .;
        build/src/AEE70.c.o(.data);
        AEF20_c = .;
        build/src/AEF20.c.o(.data);
        AEFB0_c = .;
        build/src/AEFB0.c.o(.data);
        AF040_c = .;
        build/src/AF040.c.o(.data);
        AFBA0_c = .;
        build/src/AFBA0.c.o(.data);
        B03D0_c = .;
        build/src/B03D0.c.o(.data);
        B1C20_c = .;
        build/src/B1C20.c.o(.data);
        B23D0_c = .;
        build/src/B23D0.c.o(.data);
        B24F0_c = .;
        build/src/B24F0.c.o(.data);
        B2670_c = .;
        build/src/B2670.c.o(.data);
        B26F0_c = .;
        build/src/B26F0.c.o(.data);
        B2CC0_c = .;
        build/src/B2CC0.c.o(.data);
        B2EA0_c = .;
        build/src/B2EA0.c.o(.data);
        B3230_c = .;
        build/src/B3230.c.o(.data);
        B3660_c = .;
        build/src/B3660.c.o(.data);
        B3880_c = .;
        build/src/B3880.c.o(.data);
        B3A10_c = .;
        build/src/B3A10.c.o(.data);
        B3B20_c = .;
        build/src/B3B20.c.o(.data);
        B3DF0_c = .;
        build/src/B3DF0.c.o(.data);
        B3EF0_c = .;
        build/src/B3EF0.c.o(.data);
        B4330_c = .;
        build/src/B4330.c.o(.data);
        B4390_c = .;
        build/src/B4390.c.o(.data);
        B45A0_c = .;
        build/src/B45A0.c.o(.data);
        B48B0_c = .;
        build/src/B48B0.c.o(.data);
        B4BF0_c = .;
        build/src/B4BF0.c.o(.data);
        B4D60_c = .;
        build/src/B4D60.c.o(.data);
        B5070_c = .;
        build/src/B5070.c.o(.data);
        B5090_c = .;
        build/src/B5090.c.o(.data);
        B5D70_c = .;
        build/src/B5D70.c.o(.data);
        B5E20_c = .;
        build/src/B5E20.c.o(.data);
        B5FB0_c = .;
        build/src/B5FB0.c.o(.data);
        B5FC0_c = .;
        build/src/B5FC0.c.o(.data);
        B5FD0_c = .;
        build/src/B5FD0.c.o(.data);
        B5FE0_c = .;
        build/src/B5FE0.c.o(.data);
        B60A0_c = .;
        build/src/B60A0.c.o(.data);
        B6150_c = .;
        build/src/B6150.c.o(.data);
        B61C0_c = .;
        build/src/B61C0.c.o(.data);
        B6240_c = .;
        build/src/B6240.c.o(.data);
        B62A0_c = .;
        build/src/B62A0.c.o(.data);
        B6370_c = .;
        build/src/B6370.c.o(.data);
        B6390_c = .;
        build/src/B6390.c.o(.data);
        B64D0_c = .;
        build/src/B64D0.c.o(.data);
        B6570_c = .;
        build/src/B6570.c.o(.data);
        B6580_c = .;
        build/src/B6580.c.o(.data);
        B6620_c = .;
        build/src/B6620.c.o(.data);
        B6640_c = .;
        build/src/B6640.c.o(.data);
        B66E0_c = .;
        build/src/B66E0.c.o(.data);
        B6950_c = .;
        build/src/B6950.c.o(.data);
        B6970_c = .;
        build/src/B6970.c.o(.data);
        B69C0_c = .;
        build/src/B69C0.c.o(.data);
        B6AD0_c = .;
        build/src/B6AD0.c.o(.data);
        B6AE0_c = .;
        build/src/B6AE0.c.o(.data);
        B6B20_c = .;
        build/src/B6B20.c.o(.data);
        B6B60_c = .;
        build/src/B6B60.c.o(.data);
        B6BC0_c = .;
        build/src/B6BC0.c.o(.data);
        B6C10_c = .;
        build/src/B6C10.c.o(.data);
        B6D00_c = .;
        build/src/B6D00.c.o(.data);
        B6E10_c = .;
        build/src/B6E10.c.o(.data);
        B7D10_c = .;
        build/src/B7D10.c.o(.data);
        B87A0_c = .;
        build/src/B87A0.c.o(.data);
        B89A0_c = .;
        build/src/B89A0.c.o(.data);
        B8BC0_c = .;
        build/src/B8BC0.c.o(.data);
        B8CB0_c = .;
        build/src/B8CB0.c.o(.data);
        B9070_c = .;
        build/src/B9070.c.o(.data);
        B9260_c = .;
        build/src/B9260.c.o(.data);
        B93D0_c = .;
        build/src/B93D0.c.o(.data);
        B9540_c = .;
        build/src/B9540.c.o(.data);
        B9E70_c = .;
        build/src/B9E70.c.o(.data);
        B9EC0_c = .;
        build/src/B9EC0.c.o(.data);
        B9F10_c = .;
        build/src/B9F10.c.o(.data);
        B9FA0_c = .;
        build/src/B9FA0.c.o(.data);
        B9FF0_c = .;
        build/src/B9FF0.c.o(.data);
        BA080_c = .;
        build/src/BA080.c.o(.data);
        BA0A0_c = .;
        build/src/BA0A0.c.o(.data);
        BA0C0_c = .;
        build/src/BA0C0.c.o(.data);
        BA100_c = .;
        build/src/BA100.c.o(.data);
        BA3E0_c = .;
        build/src/BA3E0.c.o(.data);
        BA630_c = .;
        build/src/BA630.c.o(.data);
        BB0B0_c = .;
        build/src/BB0B0.c.o(.data);
        BB270_c = .;
        build/src/BB270.c.o(.data);
        BB490_c = .;
        build/src/BB490.c.o(.data);
        BB5A0_c = .;
        build/src/BB5A0.c.o(.data);
        BB670_c = .;
        build/src/BB670.c.o(.data);
        BB6A0_c = .;
        build/src/BB6A0.c.o(.data);
        BB710_s = .;
        build/asm/BB710.s.o(.data);
        BB980_c = .;
        build/src/BB980.c.o(.data);
        BBC40_c = .;
        build/src/BBC40.c.o(.data);
        BBD40_c = .;
        build/src/BBD40.c.o(.data);
        build/asm/entrypoint.s.o(.rodata);
        build/src/1050.c.o(.rodata);
        build/src/4590.c.o(.rodata);
        build/src/4600.c.o(.rodata);
        build/src/71F0.c.o(.rodata);
        build/src/9410.c.o(.rodata);
        build/src/16DF0.c.o(.rodata);
        build/src/16FF0.c.o(.rodata);
        build/src/17B30.c.o(.rodata);
        build/src/1A7C0.c.o(.rodata);
        build/src/1E7A0.c.o(.rodata);
        build/src/20490.c.o(.rodata);
        build/src/21500.c.o(.rodata);
        build/src/24610.c.o(.rodata);
        build/src/2ABE0.c.o(.rodata);
        build/src/2BAB0.c.o(.rodata);
        build/src/2BC40.c.o(.rodata);
        build/src/2BD00.c.o(.rodata);
        build/src/2BE90.c.o(.rodata);
        build/src/2C020.c.o(.rodata);
        build/src/2C1C0.c.o(.rodata);
        build/src/35D90.c.o(.rodata);
        build/src/35EA0.c.o(.rodata);
        build/src/36410.c.o(.rodata);
        build/src/37090.c.o(.rodata);
        build/src/3FAD0.c.o(.rodata);
        build/src/41940.c.o(.rodata);
        build/src/59D40.c.o(.rodata);
        build/src/609D0.c.o(.rodata);
        build/src/64530.c.o(.rodata);
        build/src/7A430.c.o(.rodata);
        build/src/7BA50.c.o(.rodata);
        build/src/7CBC0.c.o(.rodata);
        build/src/7F6A0.c.o(.rodata);
        build/src/7FCE0.c.o(.rodata);
        build/src/814D0.c.o(.rodata);
        build/src/82480.c.o(.rodata);
        build/src/84490.c.o(.rodata);
        build/src/87010.c.o(.rodata);
        build/src/88690.c.o(.rodata);
        build/src/8E670.c.o(.rodata);
        build/src/8EFE0.c.o(.rodata);
        build/src/95500.c.o(.rodata);
        build/src/A06F0.c.o(.rodata);
        build/src/A5580.c.o(.rodata);
        build/src/A8E80.c.o(.rodata);
        build/src/A9D60.c.o(.rodata);
        build/src/AA020.c.o(.rodata);
        build/src/AA220.c.o(.rodata);
        build/src/AA230.c.o(.rodata);
        build/src/AA3B0.c.o(.rodata);
        build/src/AAAC0.c.o(.rodata);
        build/src/AB0B0.c.o(.rodata);
        build/src/AB6B0.c.o(.rodata);
        build/src/ABA30.c.o(.rodata);
        build/src/ABD50.c.o(.rodata);
        build/src/ABE30.c.o(.rodata);
        build/src/AC030.c.o(.rodata);
        build/src/AC100.c.o(.rodata);
        build/src/AC4C0.c.o(.rodata);
        build/src/AC4F0.c.o(.rodata);
        build/src/AC680.c.o(.rodata);
        build/src/AC6B0.c.o(.rodata);
        build/src/AC6E0.c.o(.rodata);
        build/src/AC840.c.o(.rodata);
        build/src/AC970.c.o(.rodata);
        build/src/ACB70.c.o(.rodata);
        build/src/ACC90.c.o(.rodata);
        build/src/ACCD0.c.o(.rodata);
        build/src/ACFD0.c.o(.rodata);
        build/src/AD030.c.o(.rodata);
        build/src/ADB40.c.o(.rodata);
        build/src/ADC50.c.o(.rodata);
        build/src/ADC70.c.o(.rodata);
        build/src/AE090.c.o(.rodata);
        build/src/AE140.c.o(.rodata);
        build/src/AE180.c.o(.rodata);
        build/src/AE1D0.c.o(.rodata);
        build/src/AE210.c.o(.rodata);
        build/src/AE220.c.o(.rodata);
        build/src/AE4D0.c.o(.rodata);
        build/src/AE570.c.o(.rodata);
        build/src/AE6C0.c.o(.rodata);
        build/src/AE810.c.o(.rodata);
        build/src/AE860.c.o(.rodata);
        build/src/AE8C0.c.o(.rodata);
        build/src/AEC70.c.o(.rodata);
        build/src/AED60.c.o(.rodata);
        build/src/AEE70.c.o(.rodata);
        build/src/AEF20.c.o(.rodata);
        build/src/AEFB0.c.o(.rodata);
        build/src/AF040.c.o(.rodata);
        build/src/AFBA0.c.o(.rodata);
        build/src/B03D0.c.o(.rodata);
        build/src/B1C20.c.o(.rodata);
        build/src/B23D0.c.o(.rodata);
        build/src/B24F0.c.o(.rodata);
        build/src/B2670.c.o(.rodata);
        build/src/B26F0.c.o(.rodata);
        build/src/B2CC0.c.o(.rodata);
        build/src/B2EA0.c.o(.rodata);
        build/src/B3230.c.o(.rodata);
        build/src/B3660.c.o(.rodata);
        build/src/B3880.c.o(.rodata);
        build/src/B3A10.c.o(.rodata);
        build/src/B3B20.c.o(.rodata);
        build/src/B3DF0.c.o(.rodata);
        build/src/B3EF0.c.o(.rodata);
        build/src/B4330.c.o(.rodata);
        build/src/B4390.c.o(.rodata);
        build/src/B45A0.c.o(.rodata);
        build/src/B48B0.c.o(.rodata);
        build/src/B4BF0.c.o(.rodata);
        build/src/B4D60.c.o(.rodata);
        build/src/B5070.c.o(.rodata);
        build/src/B5090.c.o(.rodata);
        build/src/B5D70.c.o(.rodata);
        build/src/B5E20.c.o(.rodata);
        build/src/B5FB0.c.o(.rodata);
        build/src/B5FC0.c.o(.rodata);
        build/src/B5FD0.c.o(.rodata);
        build/src/B5FE0.c.o(.rodata);
        build/src/B60A0.c.o(.rodata);
        build/src/B6150.c.o(.rodata);
        build/src/B61C0.c.o(.rodata);
        build/src/B6240.c.o(.rodata);
        build/src/B62A0.c.o(.rodata);
        build/src/B6370.c.o(.rodata);
        build/src/B6390.c.o(.rodata);
        build/src/B64D0.c.o(.rodata);
        build/src/B6570.c.o(.rodata);
        build/src/B6580.c.o(.rodata);
        build/src/B6620.c.o(.rodata);
        build/src/B6640.c.o(.rodata);
        build/src/B66E0.c.o(.rodata);
        build/src/B6950.c.o(.rodata);
        build/src/B6970.c.o(.rodata);
        build/src/B69C0.c.o(.rodata);
        build/src/B6AD0.c.o(.rodata);
        build/src/B6AE0.c.o(.rodata);
        build/src/B6B20.c.o(.rodata);
        build/src/B6B60.c.o(.rodata);
        build/src/B6BC0.c.o(.rodata);
        build/src/B6C10.c.o(.rodata);
        build/src/B6D00.c.o(.rodata);
        build/src/B6E10.c.o(.rodata);
        build/src/B7D10.c.o(.rodata);
        build/src/B87A0.c.o(.rodata);
        build/src/B89A0.c.o(.rodata);
        build/src/B8BC0.c.o(.rodata);
        build/src/B8CB0.c.o(.rodata);
        build/src/B9070.c.o(.rodata);
        build/src/B9260.c.o(.rodata);
        build/src/B93D0.c.o(.rodata);
        build/src/B9540.c.o(.rodata);
        build/src/B9E70.c.o(.rodata);
        build/src/B9EC0.c.o(.rodata);
        build/src/B9F10.c.o(.rodata);
        build/src/B9FA0.c.o(.rodata);
        build/src/B9FF0.c.o(.rodata);
        build/src/BA080.c.o(.rodata);
        build/src/BA0A0.c.o(.rodata);
        build/src/BA0C0.c.o(.rodata);
        build/src/BA100.c.o(.rodata);
        build/src/BA3E0.c.o(.rodata);
        build/src/BA630.c.o(.rodata);
        build/src/BB0B0.c.o(.rodata);
        build/src/BB270.c.o(.rodata);
        build/src/BB490.c.o(.rodata);
        build/src/BB5A0.c.o(.rodata);
        build/src/BB670.c.o(.rodata);
        build/src/BB6A0.c.o(.rodata);
        build/asm/BB710.s.o(.rodata);
        build/src/BB980.c.o(.rodata);
        build/src/BBC40.c.o(.rodata);
        build/src/BBD40.c.o(.rodata);
        main_DATA_END = .;
        main_BSS_START = .;
        build/asm/entrypoint.s.o(.bss);
        build/src/1050.c.o(.bss);
        build/src/4590.c.o(.bss);
        build/src/4600.c.o(.bss);
        build/src/71F0.c.o(.bss);
        build/src/9410.c.o(.bss);
        build/src/16DF0.c.o(.bss);
        build/src/16FF0.c.o(.bss);
        build/src/17B30.c.o(.bss);
        build/src/1A7C0.c.o(.bss);
        build/src/1E7A0.c.o(.bss);
        build/src/20490.c.o(.bss);
        build/src/21500.c.o(.bss);
        build/src/24610.c.o(.bss);
        build/src/2ABE0.c.o(.bss);
        build/src/2BAB0.c.o(.bss);
        build/src/2BC40.c.o(.bss);
        build/src/2BD00.c.o(.bss);
        build/src/2BE90.c.o(.bss);
        build/src/2C020.c.o(.bss);
        build/src/2C1C0.c.o(.bss);
        build/src/35D90.c.o(.bss);
        build/src/35EA0.c.o(.bss);
        build/src/36410.c.o(.bss);
        build/src/37090.c.o(.bss);
        build/src/3FAD0.c.o(.bss);
        build/src/41940.c.o(.bss);
        build/src/59D40.c.o(.bss);
        build/src/609D0.c.o(.bss);
        build/src/64530.c.o(.bss);
        build/src/7A430.c.o(.bss);
        build/src/7BA50.c.o(.bss);
        build/src/7CBC0.c.o(.bss);
        build/src/7F6A0.c.o(.bss);
        build/src/7FCE0.c.o(.bss);
        build/src/814D0.c.o(.bss);
        build/src/82480.c.o(.bss);
        build/src/84490.c.o(.bss);
        build/src/87010.c.o(.bss);
        build/src/88690.c.o(.bss);
        build/src/8E670.c.o(.bss);
        build/src/8EFE0.c.o(.bss);
        build/src/95500.c.o(.bss);
        build/src/A06F0.c.o(.bss);
        build/src/A5580.c.o(.bss);
        build/src/A8E80.c.o(.bss);
        build/src/A9D60.c.o(.bss);
        build/src/AA020.c.o(.bss);
        build/src/AA220.c.o(.bss);
        build/src/AA230.c.o(.bss);
        build/src/AA3B0.c.o(.bss);
        build/src/AAAC0.c.o(.bss);
        build/src/AB0B0.c.o(.bss);
        build/src/AB6B0.c.o(.bss);
        build/src/ABA30.c.o(.bss);
        build/src/ABD50.c.o(.bss);
        build/src/ABE30.c.o(.bss);
        build/src/AC030.c.o(.bss);
        build/src/AC100.c.o(.bss);
        build/src/AC4C0.c.o(.bss);
        build/src/AC4F0.c.o(.bss);
        build/src/AC680.c.o(.bss);
        build/src/AC6B0.c.o(.bss);
        build/src/AC6E0.c.o(.bss);
        build/src/AC840.c.o(.bss);
        build/src/AC970.c.o(.bss);
        build/src/ACB70.c.o(.bss);
        build/src/ACC90.c.o(.bss);
        build/src/ACCD0.c.o(.bss);
        build/src/ACFD0.c.o(.bss);
        build/src/AD030.c.o(.bss);
        build/src/ADB40.c.o(.bss);
        build/src/ADC50.c.o(.bss);
        build/src/ADC70.c.o(.bss);
        build/src/AE090.c.o(.bss);
        build/src/AE140.c.o(.bss);
        build/src/AE180.c.o(.bss);
        build/src/AE1D0.c.o(.bss);
        build/src/AE210.c.o(.bss);
        build/src/AE220.c.o(.bss);
        build/src/AE4D0.c.o(.bss);
        build/src/AE570.c.o(.bss);
        build/src/AE6C0.c.o(.bss);
        build/src/AE810.c.o(.bss);
        build/src/AE860.c.o(.bss);
        build/src/AE8C0.c.o(.bss);
        build/src/AEC70.c.o(.bss);
        build/src/AED60.c.o(.bss);
        build/src/AEE70.c.o(.bss);
        build/src/AEF20.c.o(.bss);
        build/src/AEFB0.c.o(.bss);
        build/src/AF040.c.o(.bss);
        build/src/AFBA0.c.o(.bss);
        build/src/B03D0.c.o(.bss);
        build/src/B1C20.c.o(.bss);
        build/src/B23D0.c.o(.bss);
        build/src/B24F0.c.o(.bss);
        build/src/B2670.c.o(.bss);
        build/src/B26F0.c.o(.bss);
        build/src/B2CC0.c.o(.bss);
        build/src/B2EA0.c.o(.bss);
        build/src/B3230.c.o(.bss);
        build/src/B3660.c.o(.bss);
        build/src/B3880.c.o(.bss);
        build/src/B3A10.c.o(.bss);
        build/src/B3B20.c.o(.bss);
        build/src/B3DF0.c.o(.bss);
        build/src/B3EF0.c.o(.bss);
        build/src/B4330.c.o(.bss);
        build/src/B4390.c.o(.bss);
        build/src/B45A0.c.o(.bss);
        build/src/B48B0.c.o(.bss);
        build/src/B4BF0.c.o(.bss);
        build/src/B4D60.c.o(.bss);
        build/src/B5070.c.o(.bss);
        build/src/B5090.c.o(.bss);
        build/src/B5D70.c.o(.bss);
        build/src/B5E20.c.o(.bss);
        build/src/B5FB0.c.o(.bss);
        build/src/B5FC0.c.o(.bss);
        build/src/B5FD0.c.o(.bss);
        build/src/B5FE0.c.o(.bss);
        build/src/B60A0.c.o(.bss);
        build/src/B6150.c.o(.bss);
        build/src/B61C0.c.o(.bss);
        build/src/B6240.c.o(.bss);
        build/src/B62A0.c.o(.bss);
        build/src/B6370.c.o(.bss);
        build/src/B6390.c.o(.bss);
        build/src/B64D0.c.o(.bss);
        build/src/B6570.c.o(.bss);
        build/src/B6580.c.o(.bss);
        build/src/B6620.c.o(.bss);
        build/src/B6640.c.o(.bss);
        build/src/B66E0.c.o(.bss);
        build/src/B6950.c.o(.bss);
        build/src/B6970.c.o(.bss);
        build/src/B69C0.c.o(.bss);
        build/src/B6AD0.c.o(.bss);
        build/src/B6AE0.c.o(.bss);
        build/src/B6B20.c.o(.bss);
        build/src/B6B60.c.o(.bss);
        build/src/B6BC0.c.o(.bss);
        build/src/B6C10.c.o(.bss);
        build/src/B6D00.c.o(.bss);
        build/src/B6E10.c.o(.bss);
        build/src/B7D10.c.o(.bss);
        build/src/B87A0.c.o(.bss);
        build/src/B89A0.c.o(.bss);
        build/src/B8BC0.c.o(.bss);
        build/src/B8CB0.c.o(.bss);
        build/src/B9070.c.o(.bss);
        build/src/B9260.c.o(.bss);
        build/src/B93D0.c.o(.bss);
        build/src/B9540.c.o(.bss);
        build/src/B9E70.c.o(.bss);
        build/src/B9EC0.c.o(.bss);
        build/src/B9F10.c.o(.bss);
        build/src/B9FA0.c.o(.bss);
        build/src/B9FF0.c.o(.bss);
        build/src/BA080.c.o(.bss);
        build/src/BA0A0.c.o(.bss);
        build/src/BA0C0.c.o(.bss);
        build/src/BA100.c.o(.bss);
        build/src/BA3E0.c.o(.bss);
        build/src/BA630.c.o(.bss);
        build/src/BB0B0.c.o(.bss);
        build/src/BB270.c.o(.bss);
        build/src/BB490.c.o(.bss);
        build/src/BB5A0.c.o(.bss);
        build/src/BB670.c.o(.bss);
        build/src/BB6A0.c.o(.bss);
        build/asm/BB710.s.o(.bss);
        build/src/BB980.c.o(.bss);
        build/src/BBC40.c.o(.bss);
        build/src/BBD40.c.o(.bss);
        main_BSS_END = .;
    }
    main_ROM_END = 0xBBD50;
    __romPos = 0xBBD50;

    __romPos = 0xBBD50;
    . = __romPos;
    BBD50_ROM_START = __romPos;
    BBD50_VRAM = ADDR(.BBD50);
    .BBD50 : AT(BBD50_ROM_START) SUBALIGN(16)
    {
        BBD50_TEXT_END = .;
        BBD50_DATA_START = .;
        BBD50_bin = .;
        build/assets/BBD50.bin.o(.data);
        BBD50_DATA_END = .;
    }
    BBD50_ROM_END = 0x2000000;
    __romPos = 0x2000000;

    /DISCARD/ :
    {
        *(*);
    }
}
